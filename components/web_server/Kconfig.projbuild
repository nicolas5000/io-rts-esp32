## sdkconfig.defaults.lilygo_lora32
```kconfig
# sdkconfig.defaults.lilygo_lora32
# Board-specific overrides for the LilyGo Lora32 T3 v1.6.1 (ESP32) with SX1276 radio.
# Committed to git — contains NO secrets (no WiFi credentials, MQTT passwords, OTA keys, etc.).
# Build: idf.py -D SDKCONFIG_DEFAULTS="sdkconfig.defaults;sdkconfig.defaults.lilygo_lora32" build

# Target chip
CONFIG_IDF_TARGET="esp32"

# Flash
CONFIG_ESPTOOLPY_FLASHSIZE_4MB=y

# Partition table
CONFIG_PARTITION_TABLE_CUSTOM=y
CONFIG_PARTITION_TABLE_OFFSET=0xf000

# Console — ESP32 uses hardware UART0, not USB Serial/JTAG (which is S3-only)
CONFIG_ESP_CONSOLE_UART_DEFAULT=y

# CPU frequency
CONFIG_ESP_DEFAULT_CPU_FREQ_MHZ_240=y

# SPI bus for SX1276 LoRa radio (SPI_HOST2)
CONFIG_SPI_HOST2_SCK=5
CONFIG_SPI_HOST2_MOSI=27
CONFIG_SPI_HOST2_MISO=19

# SX1276 control pins
CONFIG_IOHOMECONTROL_SX1276_SPI_HOST2=y
CONFIG_IOHOMECONTROL_SX1276_SPI_CS=18
CONFIG_IOHOMECONTROL_SX1276_RST=14
CONFIG_IOHOMECONTROL_SX1276_DIO0=26
CONFIG_IOHOMECONTROL_SX1276_DIO2=-1
CONFIG_IOHOMECONTROL_SX1276_DIO4=-1

# OLED display (SSD1306 on I2C)
CONFIG_OLED_ENABLED=y
CONFIG_OLED_SDA_GPIO=21
CONFIG_OLED_SCL_GPIO=22
CONFIG_OLED_RST_GPIO=-1
CONFIG_OLED_I2C_ADDR=0x3C

# Application features
CONFIG_ESP_WIFI_SOFTAP_SUPPORT=y
CONFIG_FREERTOS_HZ=1000
CONFIG_MQTT_PROTOCOL_5=y
CONFIG_HTTPD_WS_SUPPORT=y
CONFIG_WEB_ENABLED=y
CONFIG_LWIP_MAX_SOCKETS=16
CONFIG_BOOTLOADER_APP_ROLLBACK_ENABLE=y
```

## sdkconfig.defaults.lilygo_t3s3
```kconfig
# sdkconfig.defaults.lilygo_t3s3
# Board-specific overrides for the LilyGo T3S3 v1.2 (ESP32-S3) with SX1276 radio.
# Committed to git — contains NO secrets (no WiFi credentials, MQTT passwords, OTA keys, etc.).
# Build: idf.py -B build_t3s3 -D SDKCONFIG_DEFAULTS="sdkconfig.defaults;sdkconfig.defaults.lilygo_t3s3" build

# Target chip
CONFIG_IDF_TARGET="esp32s3"

# Flash
CONFIG_ESPTOOLPY_FLASHSIZE_4MB=y

# Partition table
CONFIG_PARTITION_TABLE_CUSTOM=y
CONFIG_PARTITION_TABLE_OFFSET=0xf000

# Console — ESP32-S3 uses built-in USB Serial/JTAG, not UART0
CONFIG_ESP_CONSOLE_USB_SERIAL_JTAG=y

# CPU frequency
CONFIG_ESP_DEFAULT_CPU_FREQ_MHZ_240=y

# SPI bus for SX1276 LoRa radio (SPI_HOST2)
# LilyGo T3S3 v1.2 hardware pinout
CONFIG_SPI_HOST2_SCK=5
CONFIG_SPI_HOST2_MOSI=6
CONFIG_SPI_HOST2_MISO=3

# SX1276 control pins
CONFIG_IOHOMECONTROL_SX1276_SPI_HOST2=y
CONFIG_IOHOMECONTROL_SX1276_SPI_CS=7
CONFIG_IOHOMECONTROL_SX1276_RST=8
CONFIG_IOHOMECONTROL_SX1276_DIO0=9
CONFIG_IOHOMECONTROL_SX1276_DIO2=34
CONFIG_IOHOMECONTROL_SX1276_DIO4=-1

# OLED display (SSD1306 on I2C) — no hardware reset pin on T3S3 v1.2
CONFIG_OLED_ENABLED=y
CONFIG_OLED_SDA_GPIO=18
CONFIG_OLED_SCL_GPIO=17
CONFIG_OLED_RST_GPIO=-1
CONFIG_OLED_I2C_ADDR=0x3C
CONFIG_OLED_I2C_FREQ_HZ=400000

# WiFi reset button — GPIO0 is the BOOT button on T3S3
CONFIG_WIFI_RESET_GPIO=0
CONFIG_WIFI_RESET_GPIO_HOLD_S=5

# Application features
CONFIG_ESP_WIFI_SOFTAP_SUPPORT=y
CONFIG_FREERTOS_HZ=1000
CONFIG_MQTT_PROTOCOL_5=y
CONFIG_HTTPD_WS_SUPPORT=y
CONFIG_WEB_ENABLED=y
CONFIG_LWIP_MAX_SOCKETS=16
CONFIG_BOOTLOADER_APP_ROLLBACK_ENABLE=y
CONFIG_BOARD_NAME="lilygo-t3s3"
```
