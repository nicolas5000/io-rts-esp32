## main/Kconfig.projbuild
```kconfig
menu "IO RTS Project Configuration"

    orsource "$IDF_PATH/examples/common_components/env_caps/$IDF_TARGET/Kconfig.env_caps"

    config CMD_LINE_MANAGEMENT_DEFAULT_PWD
        string "Command line password"
        default "io-rts-esp32"
        help
            Up to 32 characters. Set to empty if you don't want to protect command line access by password (unsecure).

    choice CONNECTIVITY_CHOOSE_LAYER
        prompt "Choose between Wifi and Ethernet"
        default CONNECTIVITY_CHOICE_WIFI

        config CONNECTIVITY_CHOICE_WIFI
            bool "Wifi"
            depends on SOC_WIFI_SUPPORTED
        
        config CONNECTIVITY_CHOICE_ETH
            bool "Ethernet (W5500 SPI module)"
            select ETH_USE_SPI_ETHERNET
    endchoice

    choice IP_LAYER_CHOOSE_MODE
        prompt "Choose between DHCP and static IP"
        default CONNECTIVITY_CHOICE_DHCP

        config CONNECTIVITY_CHOICE_DHCP
            bool "DHCP"
        
        config CONNECTIVITY_CHOICE_STATIC
            bool "Static IP"
    endchoice

    config IP_LAYER_HOSTNAME
        string "Hostname"
        default "io-rts-esp32"
        help
            Set hostname.

    config SNTP_TIME_SERVER
        string "SNTP server name"
        default "pool.ntp.org"
        help
            Hostname of the SNTP server.

    menu "Static IP Configuration"
        visible if CONNECTIVITY_CHOICE_STATIC

        config IP_LAYER_STATIC_IP_ADDR
        string "Static IP address"
        default "192.168.1.253"
        help
            Set static IP address.

        config IP_LAYER_STATIC_NETMASK_ADDR
            string "Static netmask address"
            default "255.255.255.0"
            help
                Set static netmask address.

        config IP_LAYER_STATIC_GW_ADDR
            string "Static gateway address"
            default "192.168.1.1"
            help
                Set static gateway address.

        config IP_LAYER_STATIC_DNS_SERVER_MAIN
            string "Main DNS server address"
            default "192.168.1.1"
            help
                Set main DNS server address.

        config IP_LAYER_STATIC_DNS_SERVER_BACKUP
            string "Backup DNS server address"
            default "192.168.1.1"
            help
                Set backup DNS server address. It can be same with the main DNS server address.
    endmenu

    menu "Wifi Configuration"
        depends on CONNECTIVITY_CHOICE_WIFI

        config ESP_WIFI_SSID
            string "WiFi SSID"
            default "myssid"
            help
                SSID (network name) to connect to.

        config ESP_WIFI_PASSWORD
            string "WiFi Password"
            default "mypassword"
            help
                WiFi password (WPA or WPA2) to use.

        choice ESP_WIFI_SAE_MODE
            prompt "WPA3 SAE mode selection"
            default ESP_STATION_WPA3_SAE_PWE_BOTH
            help
                Select mode for SAE as Hunt and Peck, H2E or both.
            config ESP_STATION_WPA3_SAE_PWE_HUNT_AND_PECK
                bool "HUNT AND PECK"
            config ESP_STATION_WPA3_SAE_PWE_HASH_TO_ELEMENT
                bool "H2E"
                depends on ESP_WIFI_ENABLE_SAE_H2E
            config ESP_STATION_WPA3_SAE_PWE_BOTH
                bool "BOTH"
                depends on ESP_WIFI_ENABLE_SAE_H2E
        endchoice

        config ESP_WIFI_PW_ID
            string "Password identifier for SAE H2E"
            depends on  ESP_STATION_WPA3_SAE_PWE_HASH_TO_ELEMENT || ESP_STATION_WPA3_SAE_PWE_BOTH
            default ""

        choice ESP_WIFI_SCAN_AUTH_MODE_THRESHOLD
            prompt "WiFi Scan auth mode threshold"
            default ESP_WIFI_AUTH_WPA2_WPA3_PSK
            help
                The weakest authmode to accept in the scan mode.
                This value defaults to ESP_WIFI_AUTH_WPA2_PSK in case password is present and ESP_WIFI_AUTH_OPEN is used.
                Please select ESP_WIFI_AUTH_WEP/ESP_WIFI_AUTH_WPA_PSK in case AP is operating in WEP/WPA mode.

            config ESP_WIFI_AUTH_OPEN
                bool "OPEN (unsecure)"
            config ESP_WIFI_AUTH_WEP
                bool "WEP (unsecure)"
            config ESP_WIFI_AUTH_WPA_PSK
                bool "WPA PSK (unsecure)"
            config ESP_WIFI_AUTH_WPA_WPA2_PSK
                bool "WPA/WPA2 PSK (unsecure)"
            config ESP_WIFI_AUTH_WPA2_PSK
                bool "WPA2 PSK"
            config ESP_WIFI_AUTH_WAPI_PSK
                bool "WAPI PSK"
            config ESP_WIFI_AUTH_WPA2_WPA3_PSK
                bool "WPA2/WPA3 PSK"
            config ESP_WIFI_AUTH_WPA3_PSK
                bool "WPA3 PSK"
        endchoice

    endmenu

    menu "WiFi Fallback AP"
        depends on CONNECTIVITY_CHOICE_WIFI

        config WIFI_FALLBACK_AP_ENABLED
            bool "Enable fallback AP when connection is lost"
            default y
            help
                When enabled, a password-protected soft-AP (io-rts-setup) starts in APSTA mode
                after repeated connection failures. The STA continues retrying the home router
                in the background; when it reconnects the AP shuts down automatically.

        config WIFI_FALLBACK_AP_RETRIES_BOOT
            int "Retries before AP starts on fresh boot (no prior connection)"
            depends on WIFI_FALLBACK_AP_ENABLED
            range 1 20
            default 3
            help
                Number of consecutive STA failures at boot before the fallback AP starts.

        config WIFI_FALLBACK_AP_RETRIES_RUNNING
            int "Retries before AP starts after a connection is lost"
            depends on WIFI_FALLBACK_AP_ENABLED
            range 1 20
            default 3
            help
                Number of consecutive failures after a previously successful connection before
                the AP starts. Avoids the AP flickering on/off during brief dropouts.

        config WIFI_FALLBACK_AP_TIMEOUT_S
            int "Fallback AP auto-shutdown timeout in seconds (0 = never)"
            depends on WIFI_FALLBACK_AP_ENABLED
            range 0 3600
            default 600

        config WIFI_RESET_GPIO
            int "WiFi credential reset GPIO (-1 to disable)"
            range -1 48
            default -1
            help
                GPIO held LOW for WIFI_RESET_GPIO_HOLD_S seconds wipes credentials and restarts.
                Configured as INPUT with internal pull-up; connect to GND to activate.

        config WIFI_RESET_GPIO_HOLD_S
            int "Hold time for credential reset (seconds)"
            depends on WIFI_RESET_GPIO >= 0
            range 3 30
            default 5

    endmenu

    menu "Ethernet Configuration"
        depends on CONNECTIVITY_CHOICE_ETH

        choice ETHERNET_SPI_HOST
            prompt "Choose SPI_HOST to use for Ethernet module"
            default ETHERNET_SPI_HOST2
            help
                You can use same SPI_HOST for Ethernet and radio modules and share SCLK, MOSI and MISO pins.

            config ETHERNET_SPI_HOST2
                bool "SPI_HOST2"
            
            config ETHERNET_SPI_HOST3
                bool "SPI_HOST3"
                depends on SOC_SPI_PERIPH_NUM > 2
        endchoice

        config ETHERNET_SPI_CLOCK_MHZ
            int "SPI clock speed (MHz) for Ethernet module"
            range 5 80
            default 40
            help
                Set the clock speed (MHz) of SPI interface. Note: some modules crash at speed greater than 60, increase carefully!

        config ETHERNET_SPI_CS_GPIO
            int "SPI CS GPIO number for SPI Ethernet module"
            range ENV_GPIO_RANGE_MIN ENV_GPIO_IN_RANGE_MAX
            default 14
            help
                Set the GPIO number used by SPI CS, i.e. Chip Select associated with the SPI Eth module).

        config ETHERNET_SPI_INT0_GPIO
            int "Interrupt GPIO number SPI Ethernet module"
            range ENV_GPIO_RANGE_MIN ENV_GPIO_IN_RANGE_MAX
            default 15
            help
                Set the GPIO number used by the SPI Ethernet module interrupt line.

        config ETHERNET_SPI_PHY_RST_GPIO
            int "PHY Reset GPIO number of SPI Ethernet Module"
            range ENV_GPIO_RANGE_MIN ENV_GPIO_OUT_RANGE_MAX
            default 16
            help
                Set the GPIO number used to reset PHY chip on the SPI Ethernet module.
    endmenu

    menu "IO Configuration"

        config IOHOMECONTROL_LOGGING_ENABLED
            bool "Enable logging in IO-HomeControl layer"
            default y

        config IOHOMECONTROL_PASSIVE_MODE
            bool "Passive only (not allowed to emit)"
            default y

        config IOHOMECONTROL_IGNORE_AUTO_UPDATE
            bool "Ignore auto-update flag and use timer value"
            default n
            help
                When enabled, the device response flag indicating a proactive status update (0x71) will be
                ignored. Instead, the estimated time provided by the device is used to schedule the next
                status poll. Enable this if your devices report the auto-update flag but you never receive
                the proactive update (e.g. because the device sends it to a different controller address).

        config IOHOMECONTROL_DEFAULT_KEY
            string "IO System key (16 bytes)"
            default "00112233445566778899AABBCCDDEEFF"
            help
                Default system key if not changed by configuration later (16 bytes)
        
        config IOHOMECONTROL_DEFAULT_NODEID
            string "IO Node ID (3 bytes)"
            default "112233"
            help
                Default Node ID if not changed by configuration later (3 bytes)

        config IOHOMECONTROL_DEFAULT_TX_POWER
            int "TX Power (dBm)"
            range 0 20
            default 20
            help
                Default Tx power in dBm (0-20)

        choice IOHOMECONTROL_SX1276_SPI_HOST
            prompt "Choose SPI_HOST to use"
            default IOHOMECONTROL_SX1276_SPI_HOST2
            help
                You can use same SPI_HOST for Ethernet and radio modules and share SCLK, MOSI and MISO pins.

            config IOHOMECONTROL_SX1276_SPI_HOST2
                bool "SPI_HOST2"
            
            config IOHOMECONTROL_SX1276_SPI_HOST3
                bool "SPI_HOST3"
                depends on SOC_SPI_PERIPH_NUM > 2
        endchoice

        config IOHOMECONTROL_SX1276_SPI_CS
            int "SPI CS GPIO Num"
            range ENV_GPIO_RANGE_MIN ENV_GPIO_OUT_RANGE_MAX
            default 7
            help
                GPIO number for SPI CS pin connected to SX1276 radio module.

        config IOHOMECONTROL_SX1276_RST
            int "RST GPIO Num"
            range ENV_GPIO_RANGE_MIN ENV_GPIO_OUT_RANGE_MAX
            default 8
            help
                GPIO number for RST pin connected to SX1276 radio module.

        config IOHOMECONTROL_SX1276_DIO0
            int "DIO0 GPIO Num"
            range ENV_GPIO_RANGE_MIN ENV_GPIO_OUT_RANGE_MAX
            default 9
            help
                GPIO number for DIO0 pin connected to SX1276 radio module.

        config IOHOMECONTROL_SX1276_DIO2
            int "DIO2 GPIO Num"
            range -1 ENV_GPIO_OUT_RANGE_MAX
            default -1
            help
                GPIO number for DIO2 pin connected to SX1276 radio module. Set -1 if not connected on your board.

        config IOHOMECONTROL_SX1276_DIO4
            int "DIO4 GPIO Num"
            range -1 ENV_GPIO_OUT_RANGE_MAX
            default 10
            help
                GPIO number for DIO4 pin connected to SX1276 radio module. Set -1 if not connected on your board.
    endmenu

    menu "MQTT Client configuration"
        config MQTT_CLIENT_ENABLE
            bool "Enable MQTT client"
            default y

        config MQTT_BROKER_ADDRESS
            string "MQTT Broker address"
            default "192.168.1.203"
            help
                MQTT broker address.
        
        config MQTT_BROKER_PORT
            int "MQTT Broker port"
            range 1 65535
            default 1883
            help
                MQTT broker listening port.
        
        config MQTT_CLIENT_ID
            string "MQTT Client ID"
            default "io-rts-esp32"
            help
                MQTT Client ID must be unique to connect to broker. It is also used as an identifier for Discovery message

        config MQTT_CLIENT_USERNAME
            string "MQTT Client username"
            default "mqtt_user"
            help
                MQTT Client username to connect to broker.

        config MQTT_CLIENT_PASSWORD
            string "MQTT Client password"
            default "mqtt_password"
            help
                MQTT Client password to connect to broker.

        config MQTT_CLIENT_TLS_ENABLED
            bool "Enable TLS to connect to broker"
            default n

        config MQTT_BROKER_CERTIFICATE
            string "MQTT broker certificate"
            default "-"
            help
                MQTT broker certificate (content of .pem file without --- BEGIN CERTIFICATE --- and ---END CERTIFICATE ---).

        config MQTT_TOPIC_PREFIX
            string "MQTT topic prefix"
            default "io-rts"
            help
                Prefix added before all MQTT topics except discovery.
        
        config MQTT_DISCOVERY_PREFIX
            string "MQTT discovery prefix"
            default "homeassistant/device/io-rts"
            help
                Prefix added before discovery topic. Discovery topic will be <MQTT_DISCOVERY_PREFIX>/config
    endmenu

    menu "SPI_HOST2 Configuration"
        depends on ETHERNET_SPI_HOST2 || IOHOMECONTROL_SX1276_SPI_HOST2

        config SPI_HOST2_SCK
            int "SPI SCK GPIO Num"
            range ENV_GPIO_RANGE_MIN ENV_GPIO_OUT_RANGE_MAX
            default 5
            help
                GPIO number for SPI SCK pin connected to SPI_HOST2.

        config SPI_HOST2_MOSI
            int "SPI MOSI GPIO Num"
            range ENV_GPIO_RANGE_MIN ENV_GPIO_OUT_RANGE_MAX
            default 6
            help
                GPIO number for SPI MOSI pin connected to SPI_HOST2.

        config SPI_HOST2_MISO
            int "SPI MISO GPIO Num"
            range ENV_GPIO_RANGE_MIN ENV_GPIO_OUT_RANGE_MAX
            default 3
            help
                GPIO number for SPI MISO pin connected to SPI_HOST2.

    endmenu

    menu "SPI_HOST3 Configuration"
        depends on ETHERNET_SPI_HOST3 || IOHOMECONTROL_SX1276_SPI_HOST3
        
        config SPI_HOST3_SCK
            int "SPI SCK GPIO Num"
            range ENV_GPIO_RANGE_MIN ENV_GPIO_OUT_RANGE_MAX
            default 11
            help
                GPIO number for SPI SCK pin connected to SPI_HOST3.

        config SPI_HOST3_MOSI
            int "SPI MOSI GPIO Num"
            range ENV_GPIO_RANGE_MIN ENV_GPIO_OUT_RANGE_MAX
            default 12
            help
                GPIO number for SPI MOSI pin connected to SPI_HOST3.

        config SPI_HOST3_MISO
            int "SPI MISO GPIO Num"
            range ENV_GPIO_RANGE_MIN ENV_GPIO_OUT_RANGE_MAX
            default 13
            help
                GPIO number for SPI MISO pin connected to SPI_HOST3.

    endmenu

    menu "Web Server Configuration"

        config WEB_ENABLED
            bool "Enable web server"
            default y
            help
                Enable the built-in HTTP/WebSocket server. Disable to save flash and RAM
                on builds that only use MQTT.

        menu "Syslog Configuration"
            depends on WEB_ENABLED

            config SYSLOG_ENABLED
                bool "Enable remote syslog"
                default n
                help
                    Forward ESP log output to a remote UDP syslog server (RFC 3164).
                    Settings can also be changed at runtime via the web UI or config_syslog command.

            config SYSLOG_SERVER
                string "Syslog server hostname or IP"
                default "syslog.speijkers.nl"
                depends on SYSLOG_ENABLED
                help
                    Hostname or IP address of the syslog server (e.g. 192.168.1.10).

            config SYSLOG_PORT
                int "Syslog UDP port"
                range 1 65535
                default 5144
                depends on SYSLOG_ENABLED
                help
                    UDP port of the syslog server. Standard port is 514.

            config SYSLOG_FACILITY
                int "Syslog facility number (0-23)"
                range 0 23
                default 1
                depends on SYSLOG_ENABLED
                help
                    RFC 3164 facility: 0=kern 1=user 2=mail 3=daemon 16-23=local0-7.

            config SYSLOG_MIN_LEVEL
                int "Minimum severity to forward (0-7)"
                range 0 7
                default 7
                depends on SYSLOG_ENABLED
                help
                    RFC 5424 severity threshold: 3=error 4=warning 6=info 7=debug.
                    Messages with severity higher than this value are dropped.

        endmenu

    endmenu

    menu "OLED Display Configuration"

        config OLED_ENABLED
            bool "Enable OLED display"
            default y

        config OLED_SDA_GPIO
            int "I2C SDA GPIO"
            default 4
            depends on OLED_ENABLED
            help
                Heltec V2 (ESP32): 4 — Heltec V3 (ESP32-S3): 17

        config OLED_SCL_GPIO
            int "I2C SCL GPIO"
            default 15
            depends on OLED_ENABLED
            help
                Heltec V2 (ESP32): 15 — Heltec V3 (ESP32-S3): 18

        config OLED_RST_GPIO
            int "RST GPIO (-1 to disable reset)"
            default 16
            depends on OLED_ENABLED
            help
                Heltec V2 (ESP32): 16 — Heltec V3 (ESP32-S3): 21 — set -1 if not wired

        config OLED_I2C_ADDR
            hex "I2C address"
            default 0x3C
            depends on OLED_ENABLED

        config OLED_I2C_FREQ_HZ
            int "I2C frequency Hz"
            default 400000
            depends on OLED_ENABLED

    endmenu

endmenu
```
